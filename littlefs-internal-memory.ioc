# file: littlefs-internal-memory.ioc
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Mcu.Family=STM32F1
Mcu.Name=STM32F103C(8-B)Tx
Mcu.Package=LQFP48
NVIC.PriorityGroup=NVIC_PRIORITYGROUP_4
PA13.Mode=Serial_Wire
PA13.Signal=SYS_JTMS-SWDIO
PA14.Mode=Serial_Wire
PA14.Signal=SYS_JTCK-SWCLK
PD0-OSC_IN.Mode=HSE-External-Oscillator
PD0-OSC_IN.Signal=RCC_OSC_IN
PD1-OSC_OUT.Mode=HSE-External-Oscillator
PD1-OSC_OUT.Signal=RCC_OSC_OUT
ProjectManager.HeapSize=0x200
ProjectManager.StackSize=0x400
ProjectManager.TargetToolchain=STM32CubeIDE
RCC.AHBFreq_Value=72000000
RCC.APB1CLKDivider=RCC_HCLK_DIV2
RCC.APB1Freq_Value=36000000
RCC.APB1TimFreq_Value=72000000
RCC.APB2Freq_Value=72000000
RCC.APB2TimFreq_Value=72000000
RCC.HCLKFreq_Value=72000000
RCC.PLLMUL=RCC_PLL_MUL9
RCC.PLLSourceVirtual=RCC_PLLSOURCE_HSE
RCC.SYSCLKFreq_VALUE=72000000
RCC.SYSCLKSource=RCC_SYSCLKSOURCE_PLLCLK
RCC.USBFreq_Value=72000000
board=custom

// file: Core/Src/main.c
/* USER CODE BEGIN Header */
/**
  ******************************************************************************
  * @file           : main.c
  * @brief          : Main program body
  ******************************************************************************
  * @attention
  *
  * Copyright (c) 2023 STMicroelectronics.
  * All rights reserved.
  *
  * This software is licensed under terms that can be found in the LICENSE file
  * in the root directory of this software component.
  * If no LICENSE file comes with this software, it is provided AS-IS.
  *
  ******************************************************************************
  */
/* USER CODE END Header */
#include "main.h"

/* USER CODE BEGIN Includes */
#include <stm32f1xx_hal_flash.h>
#include <stm32f1xx_hal_flash_ex.h>

#include "lfs.h"
/* USER CODE END Includes */

/* USER CODE BEGIN PD */
typedef struct{
	uint32_t secCount;
	uint32_t bootCount;
}app_count_t;
/* USER CODE END PD */

/* USER CODE BEGIN PV */
lfs_t Lfs;
struct lfs_config LfsConfig;

app_count_t Counter = {0};
/* USER CODE END PV */

void SystemClock_Config(void);
static void MX_GPIO_Init(void);

/* USER CODE BEGIN 0 */

// Read a region in a block. Negative error codes are propagated
// to the user.
int _flash_read(const struct lfs_config *c, lfs_block_t block,
        lfs_off_t off, void *buffer, lfs_size_t size){

	uint32_t StartAddress, i;
	uint32_t *Bff;

	StartAddress = 0x0800D800 + (block*c->block_size) + off;

	Bff = (uint32_t*)buffer;
	for (i=0 ; i<(size/4) ; i++){
		*Bff = *(__IO uint32_t*)StartAddress;
		StartAddress += 4;
		Bff++;
	}

	return LFS_ERR_OK;
}

// Program a region in a block. The block must have previously
// been erased. Negative error codes are propagated to the user.
// May return LFS_ERR_CORRUPT if the block should be considered bad.
int _flash_prog(const struct lfs_config *c, lfs_block_t block,
        lfs_off_t off, const void *buffer, lfs_size_t size){
	uint32_t StartAddress, i;
	uint32_t *Bff;

	StartAddress = 0x0800D800 + (block*c->block_size) + off;
	Bff = (uint32_t*)buffer;

	HAL_FLASH_Unlock();
	for (i=0 ; i<(size/4) ; i++){
		HAL_FLASH_Program(FLASH_TYPEPROGRAM_WORD, StartAddress, (uint64_t)(*Bff));
		StartAddress += 4;
		Bff++;
	}
	HAL_FLASH_Lock();

	return LFS_ERR_OK;
}

// Erase a block. A block must be erased before being programmed.
// The state of an erased block is undefined. Negative error codes
// are propagated to the user.
// May return LFS_ERR_CORRUPT if the block should be considered bad.
int _flash_erase(const struct lfs_config *c, lfs_block_t block){
	uint32_t StartAddress;
	uint32_t PageErr;
	FLASH_EraseInitTypeDef EraseInitStruct;

	StartAddress = 0x0800D800 + (block*c->block_size);
	EraseInitStruct.TypeErase = FLASH_TYPEERASE_PAGES;
	EraseInitStruct.PageAddress = StartAddress;
	EraseInitStruct.NbPages = 1;
	EraseInitStruct.Banks = FLASH_BANK_1;
	HAL_FLASH_Unlock();
	HAL_FLASHEx_Erase(&EraseInitStruct, &PageErr);
	HAL_FLASH_Lock();

	return LFS_ERR_OK;
}

// Sync the state of the underlying block device. Negative error codes
// are propagated to the user.
int _flash_sync(const struct lfs_config *c){
	return LFS_ERR_OK;
}

void __init_storage(){
	int32_t error;

	LfsConfig.read_size = 64;
	LfsConfig.prog_size = 64;
	LfsConfig.block_size = 1024;
	LfsConfig.block_count = 10;
	LfsConfig.cache_size = 256;
	LfsConfig.lookahead_size = 8;
	LfsConfig.block_cycles = 1000;

	LfsConfig.read = _flash_read;
	LfsConfig.prog = _flash_prog;
	LfsConfig.erase = _flash_erase;
	LfsConfig.sync = _flash_sync;

	error = lfs_mount(&Lfs, &LfsConfig);
	if (error != LFS_ERR_OK){
		lfs_format(&Lfs, &LfsConfig);
		error = lfs_mount(&Lfs, &LfsConfig);
		if (error != LFS_ERR_OK){
			Error_Handler();
		}
	}
}
/* USER CODE END 0 */

int main(void)
{
  /* USER CODE BEGIN 1 */
	uint32_t HalTickAux;
	lfs_file_t File;
  /* USER CODE END 1 */

  /* MCU Configuration--------------------------------------------------------*/

  /* Reset of all peripherals, Initializes the Flash interface and the Systick. */
  HAL_Init();

  /* Configure the system clock */
  SystemClock_Config();

  /* Initialize all configured peripherals */
  MX_GPIO_Init();
  /* USER CODE BEGIN 2 */
  HAL_Delay(100);
  __init_storage();

  lfs_file_open(&Lfs, &File, "count.bin", LFS_O_RDONLY | LFS_O_CREAT);
  lfs_file_read(&Lfs, &File, &Counter, sizeof(app_count_t));
  lfs_file_close(&Lfs, &File);

  Counter.bootCount += 1;
  /* USER CODE END 2 */

  /* Infinite loop */
  /* USER CODE BEGIN WHILE */
  while (1)
  {
	  HalTickAux = HAL_GetTick();

	  lfs_file_open(&Lfs, &File, "count.bin", LFS_O_RDWR | LFS_O_CREAT);
	  lfs_file_write(&Lfs, &File, &Counter, sizeof(app_count_t));
	  lfs_file_close(&Lfs, &File);

	  while ((HAL_GetTick() - HalTickAux) < 1000);

	  Counter.secCount += 1;
    /* USER CODE END WHILE */

  }
}

void SystemClock_Config(void)
{
  RCC_OscInitTypeDef RCC_OscInitStruct = {0};
  RCC_ClkInitTypeDef RCC_ClkInitStruct = {0};

  /** Initializes the RCC Oscillators according to the specified parameters
  * in the RCC_OscInitTypeDef structure.
  */
  RCC_OscInitStruct.OscillatorType = RCC_OSCILLATORTYPE_HSE;
  RCC_OscInitStruct.HSEState = RCC_HSE_ON;
  RCC_OscInitStruct.HSEPredivValue = RCC_HSE_PREDIV_DIV1;
  RCC_OscInitStruct.HSIState = RCC_HSI_ON;
  RCC_OscInitStruct.PLL.PLLState = RCC_PLL_ON;
  RCC_OscInitStruct.PLL.PLLSource = RCC_PLLSOURCE_HSE;
  RCC_OscInitStruct.PLL.PLLMUL = RCC_PLL_MUL9;
  if (HAL_RCC_OscConfig(&RCC_OscInitStruct) != HAL_OK)
  {
    Error_Handler();
  }

  /** Initializes the CPU, AHB and APB buses clocks
  */
  RCC_ClkInitStruct.ClockType = RCC_CLOCKTYPE_HCLK|RCC_CLOCKTYPE_SYSCLK
                              |RCC_CLOCKTYPE_PCLK1|RCC_CLOCKTYPE_PCLK2;
  RCC_ClkInitStruct.SYSCLKSource = RCC_SYSCLKSOURCE_PLLCLK;
  RCC_ClkInitStruct.AHBCLKDivider = RCC_SYSCLK_DIV1;
  RCC_ClkInitStruct.APB1CLKDivider = RCC_HCLK_DIV2;
  RCC_ClkInitStruct.APB2CLKDivider = RCC_HCLK_DIV1;

  if (HAL_RCC_ClockConfig(&RCC_ClkInitStruct, FLASH_LATENCY_2) != HAL_OK)
  {
    Error_Handler();
  }
}

static void MX_GPIO_Init(void)
{

  /* GPIO Ports Clock Enable */
  __HAL_RCC_GPIOD_CLK_ENABLE();
  __HAL_RCC_GPIOA_CLK_ENABLE();

}

void Error_Handler(void)
{
  __disable_irq();
  while (1)
  {
  }
}
